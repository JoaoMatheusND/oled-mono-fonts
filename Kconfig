## Kconfig
```kconfig
# Copyright (c) 2026, Centro de Inovação Edge.
# SPDX-License-Identifier: BSD-3-Clause

menuconfig OLED_FONTS
    bool "OLED Fonts"

    config OLED_FONT_5x7
        bool "ASCII 5x7px default font."
        default y
        depends on OLED_FONTS

    config OLED_FONT_7x10
        bool "ASCII 7x10px default font."
        default y
        depends on OLED_FONTS

    config OLED_FONT_5x7_PROP
        bool "ASCII 5x7px proportional (non-monospace) font."
        default n
        depends on OLED_FONTS

    config OLED_FONT_7x10_PROP
        bool "ASCII 7x10px proportional (non-monospace) font."
        default n
        depends on OLED_FONTS

choice
    prompt "Select a font to use"
    default FONT_DEFAULT
    depends on OLED_FONTS

    config FONT_DEFAULT
        bool "Default font"
endchoice
```
